## config/west.yml
```yaml
manifest:  
  remotes:  
    - name: zmkfirmware  
      url-base: https://github.com/zmkfirmware  
    - name: na-ka-no
      url-base: https://github.com/na-ka-no
    - name: ultimateblanks-collab
      url-base: https://github.com/ultimateblanks-collab
  
  projects:  
    - name: zmk
      remote: zmkfirmware
      revision: v0.3.0
      import: app/west.yml
    - name: zmk-pmw3610-driver  
      remote: ultimateblanks-collab
      revision: main
    - name: zmk-scroll-snap
      remote: ultimateblanks-collab
      revision: v1
   
  self:  
    path: config
```
